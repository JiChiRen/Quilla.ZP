## app/boards/gd/gd32f502ve_quilla/Kconfig.gd32f502ve_quilla
```kconfig
# Copyright (c) 2026, JiChiRen Info. Tech.
# All rights reserved.
# SPDX-License-Identifier: BSD-3-Clause

config BOARD_GD32F502VE_QUILLA
	select SOC_GD32F503
```

## app/boards/gd/gd32f502ve_quilla/board.yml
```yaml
# Copyright (c) 2026, JiChiRen Info. Tech.
# All rights reserved.
# SPDX-License-Identifier: BSD-3-Clause

board:
  name: gd32f502ve_quilla
  full_name: Quilla.ZP GD32F502VE appliance behind Quilla QBOOT
  vendor: gd
  socs:
    - name: gd32f503
```
